## drivers/sensor/pmw3389/Kconfig
```kconfig
# Copyright (c) 2022 Team Spatzenhirn
# SPDX-License-Identifier: Apache-2.0

menuconfig PMW3389
	bool "PMW3389 motion sensor"
	default y
	depends on DT_HAS_PIXART_PMW3389_ENABLED
	select SPI
	help
	  Enable PMW3389 motion sensor.

if PMW3389

config PMW3389_REPORT_INTERVAL_MIN
	int "PMW3610's default minimum report rate"
	default 10
	help
	  Default minimum report interval in milliseconds.
		Slow down input reporting for hid queue over the air.
		Turn value down to 8ms to get sharp response if use with USB only.

config PMW3389_INVERT_Y
    bool "Invert the Y axis"

endif
```
